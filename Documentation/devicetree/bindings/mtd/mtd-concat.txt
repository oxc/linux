## Documentation/devicetree/bindings/mtd/mtd-concat.txt
```
Virtual MTD concat device

Requires properties:
- devices: list of phandles to mtd nodes that should be concatenated

Example:

&spi {
	flash0: flash@0 {
		...
	};
	flash1: flash@1 {
		...
	};
};

flash {
	compatible = "mtd-concat";

	devices = <&flash0 &flash1>;
}
```
